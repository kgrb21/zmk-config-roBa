## config/west.yml
```yaml
manifest:
  remotes:
    - name: zmkfirmware
      url-base: https://github.com/zmkfirmware

  projects:
    - name: zmk
      remote: zmkfirmware
      revision: main
      import: app/west.yml
    - name: zmk-pmw3610-driver
      url: https://github.com/kumamuk-git/zmk-pmw3610-driver.git
      revision: main
    - name: zmk-kscan-gpio-charlieplex
      url: https://github.com/petejohanson/zmk-kscan-gpio-charlieplex.git
      revision: main

  self:
    path: config
```
